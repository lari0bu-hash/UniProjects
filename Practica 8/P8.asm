;PRACTICA 8: ROTABIT
;OCTUBRE 31
;LARISSA REGINA SALAZAR MONTES 
;MARCOS AARON RODRIGUEZ BERNAL
LIST		P=16F887
			INCLUDE		"P16F887.INC"
			__CONFIG	2007,24F4
			__CONFIG	2008,3FFF
			ORG		0X00
T0			EQU		0X20
T1			EQU		0X21
T2			EQU		0X22
CTK		EQU		0X23

	
GOTO  INICIO
INICIO			
			BSF		3,5
			BSF		3,6 ;BANCO3
			CLRF	ANSEL
			CLRF	ANSELH
			CLRF	TRISB
			BCF		3,5
			BCF		3,6 ;BANCO 0

REINICIO
			CLRF		CTK	 

START		
			MOVF		PORTA,W
			XORLW		.1
			BTFSS		STATUS,Z
			GOTO		REV
			MOVF		CTK	,W
			CALL		ROTAR
			MOVWF		PORTB
			CALL		DELAY
			INCF		CTK	,F
			MOVLW		.14
			XORWF		CTK,W
			BTFSS		STATUS,Z
			GOTO		START
			GOTO		REINICIO		
					

REV		
			CLRF		PORTB
			GOTO		START
			
ROTAR
			ADDWF		PCL,F
			DT		.1, .2, .4, .8, .16, .32, .64, .128, .64, .32, .16, .8, .4, .2
	
DELAY		
			MOVLW		.200
			MOVWF		T0
			MOVLW		.200
			MOVWF		T1
			MOVLW		.1
			MOVWF		T2
AQUI		
			DECFSZ		T0,1
			GOTO		AQUI
			DECFSZ		T1,1
			GOTO		AQUI
			DECFSZ		T2,1
			GOTO		AQUI
			RETURN
			END