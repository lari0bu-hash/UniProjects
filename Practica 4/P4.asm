;PRACTICA 4: CONTRASEСA
;OCTUBRE 17,2022
;LARISSA REGINA SALAZAR MONTES
;MARCOS AARON RODRIGUEZ BERNAL

		LIST	P=16F887		;INDICA EL PIC A USAR
		INCLUDE "p16F887.INC"	;CARGA LA LIBRERIA DEL PIC		
		ORG		0X00			;INDICA EL ORIGEN DEL PROGRAMA
;ESPACIO PARA DECLARAR REGISTROS;EJEMPLO: DATA EQU	0X20
		CONTRA	EQU	.5		;CONTRASEСA 10101101
		GOTO	INICIO			; IR A LA ETIQUETA DE INICIO

INICIO	BSF 	STATUS,	RP0	;PONE RP0 EN 1
		BSF 	STATUS,	RP1	;PONE RP1 EN 1
		CLRF	ANSEL		;PONE EN CEROS A ANSEL, LOS PINES DEL A Y E SON I/O DIGITAL
		CLRF	ANSELH
		BSF 	STATUS,	RP0	;PONE RP0 EN 1
		BCF 	STATUS,	RP1	;PONE RP1 EN 0
		CLRF	TRISC
		BCF		STATUS,	RP0	;PONE RP0 EN 0
		BCF		STATUS,	RP1	; PONE RP1 EN 0
	
REPETIR	
		BCF		PORTC,	1
		MOVF	PORTA,	W		;MUEVE EL CONTENIDO DEL PORTA AL REGISTRO W
		SUBLW	.5
		BTFSS	STATUS,	Z
		GOTO 	FALSE_CONTRA
		GOTO	TRUE_CONTRA		
		GOTO	REPETIR
FALSE_CONTRA
		CLRF	PORTC
		GOTO REPETIR
TRUE_CONTRA
		BSF		PORTC,	1
		RETURN

		END