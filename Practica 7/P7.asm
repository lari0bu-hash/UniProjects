;PRACTICA 7
	LIST		P=16F887
	INCLUDE 	"P16F887.INC"
	ORG    0X00

		R1 EQU 0X20
		R2 EQU 0X21
		R3 EQU 0X22

		GOTO	 INICIO	 

INICIO	BSF 	STATUS,	RP0
		BSF		STATUS,	RP1
		CLRF	ANSEL 
		CLRF	ANSELH
		CLRF	TRISB
		BCF		STATUS,	RP0
		BCF		STATUS,	RP1
	
AQUI	MOVF	PORTA,W
		ANDLW	B'00000001'
		BTFSS	STATUS,Z
		GOTO 	AQUI
		GOTO 	CERO

REV		CLRF 	PORTB
		MOVF	PORTA,W
		ANDLW	B'00000001'
		BTFSS	STATUS,Z
		GOTO 	FIN
		RETURN
	

CERO	CALL 	REV
		MOVLW	H'3F'
		MOVWF	PORTB
		CALL	DELAY
		GOTO 	UNO

UNO			
		CALL 	REV
		MOVLW	H'6'
		MOVWF	PORTB
		CALL	DELAY
		GOTO 	DOS

DOS		
		CALL 	REV
		MOVLW	H'5B'
		MOVWF	PORTB
		CALL	DELAY	
		GOTO 	TRES

TRES	CALL 	REV
		MOVLW	H'4F'
		MOVWF	PORTB
		CALL	DELAY
		GOTO 	CUATRO


CUATRO	CALL 	REV
		MOVLW	H'66'
		MOVWF	PORTB
		CALL	DELAY
		GOTO 	CINCO

CINCO	CALL 	REV
		MOVLW	H'6D'
		MOVWF	PORTB
		CALL	DELAY
		GOTO 	SEIS

SEIS	
		CALL 	REV
		MOVLW	H'7D'
		MOVWF	PORTB
		CALL	DELAY
		GOTO 	SIETE

SIETE 	
		CALL 	REV
		MOVLW	H'7'
		MOVWF	PORTB
		CALL	DELAY
		GOTO 	OCHO

OCHO	
		CALL 	REV
		MOVLW	H'7F'
		MOVWF	PORTB
		CALL	DELAY
		GOTO 	NUEVE

NUEVE	
		CALL 	REV
		MOVLW	H'6F'
		MOVWF	PORTB
		CALL	DELAY
		GOTO 	AQUI
DELAY
	MOVLW .100
	MOVWF R1
	MOVLW .50
	MOVWF R2
	MOVLW .10
	MOVWF R3

LOOP 
	DECFSZ R1, 1
	GOTO LOOP
	DECFSZ R2, 1
	GOTO LOOP
	DECFSZ R3, 1
	GOTO LOOP
	RETURN
FIN
	END