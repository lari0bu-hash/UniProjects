
		LIST	P=16F887		;INDICA EL PIC A USAR
		INCLUDE "p16F887.INC"	;CARGA LA LIBRERIA DEL PIC		
		ORG		0X00			;INDICA EL ORIGEN DEL PROGRAMA
;ESPACIO PARA DECLARAR REGISTROS;EJEMPLO: DATA EQU	0X20
		R0		EQU	0X20
		R1		EQU	0X21	
		R2		EQU	0X22
		GOTO	INICIO			; IR A LA ETIQUETA DE INICIO

INICIO	
	BSF 	STATUS,	RP0	;PONE RP0 EN 1
	CLRF	TRISC
	BSF 	STATUS,	RP1	;PONE RP1 EN 1
	CLRF	ANSEL		;PONE EN CEROS A ANSEL, LOS PINES DEL A Y E SON I/O DIGITAL
	CLRF	ANSELH
	BCF		STATUS,	RP0	;PONE RP0 EN 0
	BCF		STATUS,	RP1	; PONE RP1 EN 0
REPETIR
	MOVF	PORTA,	W
	SUBLW	.1
	BTFSS	STATUS,	Z
	GOTO 	REPETIR
	GOTO	ENCENDER
ENCENDER
	BSF		PORTC,	0
	CALL	TIME
	BCF		PORTC,	0
	BSF		PORTC,	1
	CALL	TIME
	BCF		PORTC,	1
	GOTO	REPETIR
TIME
	MOVLW	.100
	MOVWF	R0
	MOVLW	.50
	MOVWF	R1
	MOVLW	.2
	MOVWF	R2
AQUI
	DECFSZ	R0
	GOTO	AQUI
	DECFSZ	R1
	GOTO	AQUI
	DECFSZ	R2
	GOTO	AQUI	
	RETURN
END