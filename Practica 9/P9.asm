
		LIST	P=16F887		;INDICA EL PIC A USAR
		INCLUDE "p16F887.INC"	;CARGA LA LIBRERIA DEL PIC		
		ORG		0X00			;INDICA EL ORIGEN DEL PROGRAMA
		;ESPACIO PARA DECLARAR REGISTROS;EJEMPLO: DATA EQU	0X20
		R0	EQU	0X20
		R1	EQU	0X21	
		R2	EQU	0X22
		GOTO	INICIO			; IR A LA ETIQUETA DE INICIO

INICIO	
	BSF 	STATUS,	RP0	;PONE RP0 EN 1
	CLRF	TRISC
	BSF 	STATUS,	RP1	;PONE RP1 EN 1
	CLRF	ANSEL		;PONE EN CEROS A ANSEL, LOS PINES DEL A Y E SON I/O DIGITAL
	CLRF	ANSELH
	CLRF	TRISB		;PONE A TRISB COMO SALIDA/ENTRADA DIGTALES
	BCF		STATUS,	RP0	;PONE RP0 EN 0
	BCF		STATUS,	RP1	; PONE RP1 EN 0
	
AQUI
	CALL 	DIESCINUEVE
	BTFSC	PORTE,	3
	GOTO 	AQUI
	GOTO	START
	
	
DIESCINUEVE
		MOVLW	b'11101111'		; 9, carga b'1111011' en W y retorna
		MOVWF	PORTB
		RETURN
		
START
	CALL	DIESCINUEVE
	CALL	DELAY
	CALL	DELAY
	CALL	DIESIOCHO
	CALL	DELAY
	CALL	DELAY
	CALL	DIESISIETE
	CALL	DELAY
	CALL	DELAY
	CALL	DIESISEIS
	CALL	DELAY
	CALL	DELAY
	CALL	QUINCE
	CALL 	DELAY
	CALL	DELAY
	CALL 	CATORCE
	CALL	DELAY
	CALL	DELAY
	CALL 	TRECE
	CALL	DELAY
	CALL	DELAY
	CALL 	DOCE
	CALL	DELAY
	CALL	DELAY
	CALL	ONCE
	CALL 	DELAY
	CALL	DELAY
	CALL 	DIEZ
	CALL	DELAY
	CALL	DELAY
	CALL	NUEVE
	CALL	DELAY
	CALL	DELAY
	CALL	OCHO
	CALL	DELAY
	CALL	DELAY
	CALL	SIETE
	CALL	DELAY
	CALL	DELAY
	CALL	SEIS
	CALL	DELAY
	CALL	DELAY
	CALL	CINCO
	CALL	DELAY
	CALL	DELAY
	CALL	CUATRO
	CALL	DELAY
	CALL	DELAY
	CALL	TRES
	CALL	DELAY
	CALL	DELAY
	CALL	DOS
	CALL	DELAY
	CALL	DELAY
	CALL	UNO
	CALL	DELAY
	CALL	DELAY
	CALL	CERO
	CALL	BUFFER
	CALL 	BUFFER
	CALL	BUFFER
	GOTO	AQUI
TIME
	MOVLW	.200
	MOVWF	R0
	MOVLW	.2
	MOVWF	R1
;	MOVLW	.1
;	MOVWF	R2

DELAY
	DECFSZ	R0
	GOTO	DELAY
	DECFSZ	R1
;	GOTO	DELAY
;	DECFSZ	R2
	GOTO	DELAY	
	RETURN
	
CERO
	MOVLW	B'00111111'		; 0, carga b'1111110' en W y retorna
	MOVWF	PORTB
	RETURN
UNO
	MOVLW	b'00000110'		; 1, carga b'0110000' en W y retorna
	MOVWF	PORTB
	RETURN
DOS
	MOVLW	b'01011011'		; 2, carga b'1101101' en W y retorna
	MOVWF	PORTB
	RETURN
TRES
	MOVLW	b'01001111'		; 3, carga b'1111001' en W y retorna
	MOVWF	PORTB
	RETURN
CUATRO
	MOVLW	b'01100110'		; 4, carga b'0110011' en W y retorna
	MOVWF	PORTB
	RETURN
CINCO
	MOVLW	b'01101101'		; 5, carga b'1011011' en W y retorna
	MOVWF	PORTB
	RETURN
SEIS
	MOVLW	b'01111101'		; 6, carga b'1011111' en W y retorna
	MOVWF	PORTB
	RETURN
SIETE
	MOVLW	b'00000111'		; 7, carga b'1110000' en W y retorna
	MOVWF	PORTB
	RETURN
OCHO
	MOVLW	b'01111111'		; 8, carga b'1111111' en W y retorna
	MOVWF	PORTB
	RETURN
NUEVE
	MOVLW	b'01101111'		; 9, carga b'1111011' en W y retorna
	MOVWF	PORTB
	RETURN		
DIEZ
	MOVLW	B'10111111'
	MOVWF	PORTB	
	RETURN	
ONCE
	MOVLW	b'10000110'		; 11, carga b'0110000' en W y retorna
	MOVWF	PORTB
	RETURN
DOCE
	MOVLW	b'11011011'		; 12, carga b'1101101' en W y retorna
	MOVWF	PORTB
	RETURN
TRECE
	MOVLW	b'11001111'		; 13, carga b'1111001' en W y retorna
	MOVWF	PORTB
	RETURN
CATORCE
	MOVLW	b'11100110'		; 14, carga b'0110011' en W y retorna
	MOVWF	PORTB
	RETURN
QUINCE
	MOVLW	b'11101101'		; 15, carga b'1011011' en W y retorna
	MOVWF	PORTB
	RETURN
DIESISEIS
	MOVLW	b'11111101'		; 16, carga b'1011111' en W y retorna
	MOVWF	PORTB
	RETURN
DIESISIETE
	MOVLW	b'10000111'		; 17, carga b'1110000' en W y retorna
	MOVWF	PORTB
	RETURN
DIESIOCHO
	MOVLW	b'11111111'		; 18, carga b'1111111' en W y retorna
	MOVWF	PORTB
	RETURN
BUFFER
	MOVLW	.1
	MOVWF	PORTC
	CALL	DELAY
	CALL	DELAY
	MOVLW	.0
	MOVWF	PORTC
	CALL	DELAY
	CALL	DELAY
	RETURN
END					